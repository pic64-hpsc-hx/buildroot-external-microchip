## configs/p64h_hwemu_defconfig
```kconfig
BR2_riscv=y
BR2_TOOLCHAIN_EXTERNAL=y
BR2_TOOLCHAIN_EXTERNAL_P64H=y
BR2_TOOLCHAIN_EXTERNAL_PREINSTALLED=y
BR2_TOOLCHAIN_EXTERNAL_PATH="$(RISCV_PATH)"
BR2_PACKAGE_HOST_GDB=y
BR2_PACKAGE_HOST_GDB_TUI=y
BR2_PACKAGE_HOST_GDB_PYTHON3=y
BR2_GDB_VERSION_17=y
BR2_CCACHE=y
BR2_OPTIMIZE_S=y
BR2_PACKAGE_OVERRIDE_FILE="$(BR2_EXTERNAL_P64H_PACKAGE_OVERRIDE_FILE)"
BR2_GLOBAL_PATCH_DIR="$(BR2_EXTERNAL_MCHP_PATH)/board/microchip/p64h/patches"
BR2_TARGET_GENERIC_HOSTNAME="p64h-hwemu"
BR2_TARGET_GENERIC_ISSUE="Welcome to PIC64 HPSC/HX HWEMU Buildroot"
BR2_ROOTFS_DEVICE_CREATION_STATIC=y
BR2_ROOTFS_OVERLAY="$(BR2_EXTERNAL_MCHP_PATH)/board/microchip/p64h/common-overlay/ $(BR2_EXTERNAL_MCHP_PATH)/board/microchip/p64h/hwemu/overlay/"
BR2_ROOTFS_POST_BUILD_SCRIPT="$(BR2_EXTERNAL_MCHP_PATH)/board/microchip/p64h/common-scripts/compress_image.sh"
BR2_LINUX_KERNEL=y
BR2_LINUX_KERNEL_CUSTOM_GIT=y
BR2_LINUX_KERNEL_CUSTOM_REPO_URL="git@github.com:pic64-hpsc-hx/linux.git"
BR2_LINUX_KERNEL_CUSTOM_REPO_VERSION="1c1e0c102f4fe030294f759d203b9b25f7348c4b"
BR2_LINUX_KERNEL_USE_CUSTOM_CONFIG=y
BR2_LINUX_KERNEL_CUSTOM_CONFIG_FILE="$(BR2_EXTERNAL_MCHP_PATH)/board/microchip/p64h/hwemu/linux.config"
BR2_PACKAGE_LINUX_TOOLS_PERF=y
BR2_PACKAGE_BUSYBOX_CONFIG="$(BR2_EXTERNAL_MCHP_PATH)/board/microchip/p64h/hwemu/busybox.config"
BR2_PACKAGE_HAVEGED=y
BR2_TARGET_ROOTFS_CPIO=y
BR2_TARGET_ROOTFS_CPIO_GZIP=y
# BR2_TARGET_ROOTFS_TAR is not set
BR2_PACKAGE_HOST_E2FSPROGS=y
BR2_PACKAGE_P64H=y
BR2_PACKAGE_P64H_PLATFORM="hwemu"
BR2_PACKAGE_P64H_BENCHMARKS=y
BR2_PACKAGE_P64H_BENCHMARKS_COREMARK=y
BR2_PACKAGE_P64H_BENCHMARKS_HACC=y
BR2_PACKAGE_P64H_BENCHMARKS_HPCC=y
BR2_PACKAGE_P64H_BENCHMARKS_MICROBENCH=y
BR2_PACKAGE_P64H_BENCHMARKS_PERLIN=y
BR2_PACKAGE_P64H_BENCHMARKS_SPACEBENCH=y
BR2_PACKAGE_P64H_BENCHMARKS_STREAM=y
BR2_PACKAGE_P64H_EXAMPLES=y
BR2_PACKAGE_P64H_EXAMPLES_RPMI_RAS=y
BR2_PACKAGE_P64H_EXAMPLES_TEST_AUTOMATION=y
BR2_PACKAGE_P64H_LKMS=y
BR2_PACKAGE_P64H_LKMS_P64H_UIO_DRIVER=y
BR2_PACKAGE_P64H_LKMS_X288_L2PF_DRIVER=y
```

## configs/p64h_hwemu_lite_defconfig
```kconfig
BR2_riscv=y
BR2_TOOLCHAIN_EXTERNAL=y
BR2_TOOLCHAIN_EXTERNAL_P64H=y
BR2_TOOLCHAIN_EXTERNAL_PREINSTALLED=y
BR2_TOOLCHAIN_EXTERNAL_PATH="$(RISCV_PATH)"
BR2_CCACHE=y
BR2_OPTIMIZE_S=y
BR2_PACKAGE_OVERRIDE_FILE="$(BR2_EXTERNAL_P64H_PACKAGE_OVERRIDE_FILE)"
BR2_GLOBAL_PATCH_DIR="$(BR2_EXTERNAL_MCHP_PATH)/board/microchip/p64h/patches"
BR2_TARGET_GENERIC_HOSTNAME="p64h-hwemu-lite"
BR2_TARGET_GENERIC_ISSUE="Welcome to PIC64 HPSC/HX HWEMU-LITE Buildroot"
BR2_ROOTFS_DEVICE_CREATION_STATIC=y
BR2_ROOTFS_OVERLAY="$(BR2_EXTERNAL_MCHP_PATH)/board/microchip/p64h/common-overlay/ $(BR2_EXTERNAL_MCHP_PATH)/board/microchip/p64h/hwemu_lite/overlay/"
BR2_ROOTFS_POST_BUILD_SCRIPT="$(BR2_EXTERNAL_MCHP_PATH)/board/microchip/p64h/common-scripts/compress_image.sh"
BR2_LINUX_KERNEL=y
BR2_LINUX_KERNEL_CUSTOM_GIT=y
BR2_LINUX_KERNEL_CUSTOM_REPO_URL="git@github.com:pic64-hpsc-hx/linux.git"
BR2_LINUX_KERNEL_CUSTOM_REPO_VERSION="1c1e0c102f4fe030294f759d203b9b25f7348c4b"
BR2_LINUX_KERNEL_USE_CUSTOM_CONFIG=y
BR2_LINUX_KERNEL_CUSTOM_CONFIG_FILE="$(BR2_EXTERNAL_MCHP_PATH)/board/microchip/p64h/hwemu/linux.config"
BR2_PACKAGE_BUSYBOX_CONFIG="$(BR2_EXTERNAL_MCHP_PATH)/board/microchip/p64h/hwemu_lite/busybox.config"
BR2_TARGET_ROOTFS_CPIO=y
BR2_TARGET_ROOTFS_CPIO_GZIP=y
# BR2_TARGET_ROOTFS_TAR is not set
BR2_PACKAGE_HOST_E2FSPROGS=y
# BR2_TOOLCHAIN_EXTERNAL_P64H_COPY_TOOLCHAIN_SYSROOT is not set
BR2_PACKAGE_P64H=y
BR2_PACKAGE_P64H_PLATFORM="hwemu"
BR2_PACKAGE_P64H_EXAMPLES=y
BR2_PACKAGE_P64H_EXAMPLES_HELLO=y
BR2_PACKAGE_P64H_EXAMPLES_RPMI_RAS=y
BR2_PACKAGE_P64H_EXAMPLES_UIO_SHAREDMEM=y
BR2_PACKAGE_P64H_EXAMPLES_UTILS=y
BR2_PACKAGE_P64H_LKMS_P64H_UIO_DRIVER=y
BR2_PACKAGE_P64H_LKMS_GPIO_DRIVER=y
BR2_PACKAGE_P64H_LKMS_PCIE_DRIVER=y
BR2_PACKAGE_P64H_LKMS_X288_L2PF_DRIVER=y
```

## configs/p64h_lite_defconfig
```kconfig
BR2_riscv=y
BR2_TOOLCHAIN_EXTERNAL=y
BR2_TOOLCHAIN_EXTERNAL_P64H=y
BR2_TOOLCHAIN_EXTERNAL_PREINSTALLED=y
BR2_TOOLCHAIN_EXTERNAL_PATH="$(RISCV_PATH)"
BR2_CCACHE=y
BR2_OPTIMIZE_S=y
BR2_PACKAGE_OVERRIDE_FILE="$(BR2_EXTERNAL_P64H_PACKAGE_OVERRIDE_FILE)"
BR2_GLOBAL_PATCH_DIR="$(BR2_EXTERNAL_MCHP_PATH)/board/microchip/p64h/patches"
BR2_TARGET_GENERIC_HOSTNAME="p64h-lite"
BR2_TARGET_GENERIC_ISSUE="Welcome to PIC64 HPSC/HX QEMU-LITE Buildroot"
BR2_ROOTFS_DEVICE_CREATION_STATIC=y
BR2_ROOTFS_OVERLAY="$(BR2_EXTERNAL_MCHP_PATH)/board/microchip/p64h/p64h_lite/overlay/"
BR2_ROOTFS_POST_BUILD_SCRIPT="$(BR2_EXTERNAL_MCHP_PATH)/board/microchip/p64h/common-scripts/compress_image.sh"
BR2_LINUX_KERNEL=y
BR2_LINUX_KERNEL_CUSTOM_TARBALL=y
BR2_LINUX_KERNEL_CUSTOM_TARBALL_LOCATION="https://github.com/linux4microchip/linux/archive/refs/tags/linux4microchip+fpga-2025.07.tar.gz"
BR2_LINUX_KERNEL_USE_CUSTOM_CONFIG=y
BR2_LINUX_KERNEL_CUSTOM_CONFIG_FILE="$(BR2_EXTERNAL_MCHP_PATH)/board/microchip/p64h/p64h_lite/linux.config"
BR2_PACKAGE_LINUX_TOOLS_GPIO=y
BR2_PACKAGE_LINUX_TOOLS_PERF=y
BR2_PACKAGE_LINUX_TOOLS_PERF_SCRIPTS=y
BR2_PACKAGE_LINUX_TOOLS_PERF_TUI=y
BR2_PACKAGE_LINUX_TOOLS_PERF_NEEDS_HOST_PYTHON3=y
BR2_PACKAGE_BUSYBOX_CONFIG="$(BR2_EXTERNAL_MCHP_PATH)/board/microchip/p64h/p64h_lite/busybox.config"
BR2_PACKAGE_MTD=y
BR2_PACKAGE_MTD_LSMTD=y
BR2_PACKAGE_MTD_MKFSUBIFS=y
BR2_PACKAGE_MTD_MTDPART=y
BR2_PACKAGE_MTD_TESTS=y
BR2_PACKAGE_MTD_FLASH_READTEST=y
BR2_PACKAGE_MTD_FLASH_SPEED=y
BR2_PACKAGE_MTD_FLASH_STRESS=y
BR2_PACKAGE_MTD_FLASH_TORTURE=y
BR2_PACKAGE_MTD_NANDPAGETEST=y
BR2_PACKAGE_LIBUIO=y
BR2_PACKAGE_LSUIO=y
BR2_PACKAGE_MDIO_TOOLS=y
BR2_PACKAGE_MEMTESTER=y
BR2_PACKAGE_LIBXCRYPT=y
BR2_PACKAGE_LIBGPIOD2=y
BR2_PACKAGE_LIBGPIOD2_TOOLS=y
BR2_PACKAGE_LIBPCAP=y
BR2_PACKAGE_MII_DIAG=y
BR2_PACKAGE_OPENSSH=y
# BR2_PACKAGE_OPENSSH_SERVER is not set
BR2_TARGET_ROOTFS_CPIO=y
BR2_TARGET_ROOTFS_CPIO_GZIP=y
# BR2_TARGET_ROOTFS_TAR is not set
BR2_TARGET_ROOTFS_UBI=y
BR2_PACKAGE_HOST_E2FSPROGS=y
# BR2_TOOLCHAIN_EXTERNAL_P64H_COPY_TOOLCHAIN_SYSROOT is not set
BR2_PACKAGE_P64H=y
BR2_PACKAGE_P64H_LKMS=y
BR2_PACKAGE_P64H_LKMS_UIO_SHAREDMEM_DRIVER=y
BR2_PACKAGE_P64H_LKMS_P64H_UIO_DRIVER=y
BR2_PACKAGE_P64H_LKMS_APPDMA_DRIVER=y
BR2_PACKAGE_P64H_LKMS_XSPI_DRIVER=y
BR2_PACKAGE_P64H_LKMS_GPIO_DRIVER=y
BR2_PACKAGE_P64H_LKMS_WDT_DRIVER=y
BR2_PACKAGE_P64H_LKMS_HPT_DRIVER=y
BR2_PACKAGE_P64H_LKMS_IPC_DEMO_DRIVER=y
BR2_PACKAGE_P64H_LKMS_PCIE_DRIVER=y
```

## configs/p64h_qemu_defconfig
```kconfig
BR2_riscv=y
BR2_TOOLCHAIN_EXTERNAL=y
BR2_TOOLCHAIN_EXTERNAL_CUSTOM=y
BR2_TOOLCHAIN_EXTERNAL_PATH="$(RISCV_PATH)"
BR2_TOOLCHAIN_EXTERNAL_CUSTOM_PREFIX="riscv64-unknown-linux-gnu"
BR2_TOOLCHAIN_EXTERNAL_HEADERS_6_2=y
BR2_TOOLCHAIN_EXTERNAL_CUSTOM_GLIBC=y
# BR2_TOOLCHAIN_EXTERNAL_INET_RPC is not set
BR2_TOOLCHAIN_EXTERNAL_CXX=y
BR2_TOOLCHAIN_EXTERNAL_OPENMP=y
BR2_TOOLCHAIN_EXTERNAL_FORTRAN=y
BR2_TOOLCHAIN_EXTERNAL_GCC_13=y
BR2_TOOLCHAIN_EXTRA_LIBS="riscv64-unknown-linux-gnu-gdb riscv64-unknown-linux-gnu-gprof"
BR2_CCACHE=y
BR2_STRIP_EXCLUDE_FILES="hpsc_hello"
BR2_PACKAGE_OVERRIDE_FILE="$(BR2_EXTERNAL_MCHP_PATH)/board/microchip/p64h_qemu/override.mk"
BR2_GLOBAL_PATCH_DIR="$(BR2_EXTERNAL_MCHP_PATH)/board/microchip/p64h_qemu/patches"
BR2_TARGET_GENERIC_HOSTNAME="hpsc"
BR2_TARGET_GENERIC_ISSUE="Welcome to HPSC Buildroot"
BR2_ROOTFS_DEVICE_CREATION_STATIC=y
BR2_ROOTFS_OVERLAY="$(BR2_EXTERNAL_MCHP_PATH)/board/microchip/p64h_qemu/overlay/"
BR2_ROOTFS_POST_IMAGE_SCRIPT="$(BR2_EXTERNAL_MCHP_PATH)/board/microchip/p64h_qemu/post-image.sh"
BR2_PACKAGE_BUSYBOX_CONFIG="$(BR2_EXTERNAL_MCHP_PATH)/board/microchip/p64h_qemu/busybox.config"
#
# Linux Kernel
#
BR2_LINUX_KERNEL=y
BR2_LINUX_KERNEL_CUSTOM_GIT=y
BR2_LINUX_KERNEL_CUSTOM_REPO_URL="git@bitbucket.microchip.com:hpsc/linux.git"
BR2_LINUX_KERNEL_CUSTOM_REPO_VERSION="b1faba9a91d8f0f45a13763b5a59591cd9afda7d"
BR2_LINUX_KERNEL_USE_CUSTOM_CONFIG=y
BR2_LINUX_KERNEL_CUSTOM_CONFIG_FILE="$(BR2_EXTERNAL_MCHP_PATH)/board/microchip/p64h_qemu/linux_6.6.9.config"

# GCC optimization levels
# optimize for size - -Os enables all -O2 optimizations except those that increase program size
BR2_OPTIMIZE_S=y  
# BR2_OPTIMIZE_2=y

BR2_GDB_VERSION_12=y
BR2_PACKAGE_LINUX_TOOLS_PERF=y
BR2_PACKAGE_HOST_GDB=y
BR2_PACKAGE_HOST_GDB_SIM=y
# Enable GDB on the target
BR2_PACKAGE_GDB_ARCH_SUPPORTS=y
BR2_PACKAGE_GDB=y
BR2_PACKAGE_GDB_DEBUGGER=y
BR2_PACKAGE_SSHFS=y
BR2_PACKAGE_HWLOC=y
BR2_PACKAGE_LIBCONFUSE=y
BR2_PACKAGE_LIBUEV=y
BR2_PACKAGE_LIBITE=y
BR2_PACKAGE_HAVEGED=y
BR2_PACKAGE_CPULOAD=y
BR2_PACKAGE_NUMACTL=y
BR2_PACKAGE_UTIL_LINUX=y
BR2_PACKAGE_UTIL_LINUX_SCHEDUTILS=y
BR2_TARGET_ROOTFS_CPIO=y
BR2_TARGET_ROOTFS_CPIO_GZIP=y
BR2_PACKAGE_HOST_E2FSPROGS=y
# Do not startup the network service
BR2_PACKAGE_IFUPDOWN_SCRIPTS=n

#
# P64H Packages
#
BR2_PACKAGE_P64H_DEFAULT_GIT=y
#BR2_PACKAGE_P64H_CUSTOM_LOCAL=y
#BR2_PACKAGE_P64H_CUSTOM_LOCAL_PATH="./../p64h-linux-examples"
BR2_PACKAGE_P64H_EXAMPLES=y
BR2_PACKAGE_P64H_BENCHMARKS=y
```

## configs/p64h_qemu_test_defconfig
```kconfig
BR2_riscv=y
# if you want to run gdb inside qemu or protium then don't strip debugging symbols
#BR2_STRIP_strip=n
BR2_STRIP_strip=y
BR2_TOOLCHAIN_EXTERNAL=y
BR2_TOOLCHAIN_EXTERNAL_PREINSTALLED=y
BR2_TOOLCHAIN_EXTERNAL_P64H=y
BR2_TOOLCHAIN_EXTERNAL_PATH="$(RISCV_PATH)"
BR2_TOOLCHAIN_EXTERNAL_CUSTOM_PREFIX="riscv64-unknown-linux-gnu"
BR2_TOOLCHAIN_EXTERNAL_HEADERS_6_6=y
BR2_TOOLCHAIN_EXTERNAL_CUSTOM_GLIBC=y
# BR2_TOOLCHAIN_EXTERNAL_INET_RPC is not set
BR2_TOOLCHAIN_EXTERNAL_CXX=y
BR2_TOOLCHAIN_EXTERNAL_OPENMP=y
BR2_TOOLCHAIN_EXTERNAL_FORTRAN=y
BR2_TOOLCHAIN_EXTERNAL_GCC_14_2=y
BR2_TOOLCHAIN_EXTERNAL_GCC_VERSION_14=y
BR2_CCACHE=y
BR2_PACKAGE_OVERRIDE_FILE="$(BR2_EXTERNAL_P64H_PACKAGE_OVERRIDE_FILE)"
BR2_GLOBAL_PATCH_DIR="$(BR2_EXTERNAL_MCHP_PATH)/board/microchip/p64h/patches"
BR2_TARGET_GENERIC_HOSTNAME="p64h-qemu-test"
BR2_TARGET_GENERIC_ISSUE="Welcome to PIC64 HPSC/HX QEMU Buildroot"
BR2_ROOTFS_DEVICE_CREATION_STATIC=y
BR2_ROOTFS_OVERLAY="$(BR2_EXTERNAL_MCHP_PATH)/board/microchip/p64h/qemu/overlay/"
BR2_PACKAGE_BUSYBOX_CONFIG="$(BR2_EXTERNAL_MCHP_PATH)/board/microchip/p64h/qemu/busybox.config"
BR2_ROOTFS_POST_BUILD_SCRIPT="$(BR2_EXTERNAL_MCHP_PATH)/board/microchip/p64h/common-scripts/compress_image.sh"
#
# Kernel
#
BR2_LINUX_KERNEL=y
BR2_LINUX_KERNEL_CUSTOM_TARBALL=y
BR2_LINUX_KERNEL_CUSTOM_TARBALL_LOCATION="https://github.com/pic64-hpsc-hx/linux/archive/refs/tags/linux4microchip+p64h-2025.03-rc1.tar.gz"
BR2_LINUX_KERNEL_VERSION="custom"
BR2_LINUX_KERNEL_PATCH=""
BR2_LINUX_KERNEL_USE_CUSTOM_CONFIG=y
BR2_LINUX_KERNEL_CUSTOM_CONFIG_FILE="$(BR2_EXTERNAL_MCHP_PATH)/board/microchip/p64h/qemu/linux.config"
BR2_LINUX_KERNEL_CONFIG_FRAGMENT_FILES=""
BR2_LINUX_KERNEL_CUSTOM_LOGO_PATH=""
BR2_LINUX_KERNEL_IMAGE=y
BR2_LINUX_KERNEL_GZIP=y

# GCC optimization levels
# optimize for size - -Os enables all -O2 optimizations except those that increase program size
BR2_OPTIMIZE_S=y
# BR2_OPTIMIZE_2=y

BR2_GDB_VERSION_14=y
BR2_PACKAGE_LINUX_TOOLS_PERF=y
BR2_PACKAGE_HOST_GDB=y
BR2_PACKAGE_HOST_GDB_TUI=y
BR2_PACKAGE_HOST_GDB_PYTHON3=y
# Enable GDB on the target
BR2_PACKAGE_GDB_ARCH_SUPPORTS=y
BR2_PACKAGE_GDB=y
BR2_PACKAGE_GDB_SERVER=y
BR2_PACKAGE_GDB_DEBUGGER=y
BR2_PACKAGE_GDB_TUI=y
BR2_PACKAGE_SSHFS=y
BR2_PACKAGE_HWLOC=y
BR2_PACKAGE_LIBCONFUSE=y
BR2_PACKAGE_LIBUEV=y
BR2_PACKAGE_LIBITE=y
BR2_PACKAGE_HAVEGED=y
BR2_PACKAGE_CPULOAD=y
BR2_PACKAGE_NUMACTL=y
BR2_PACKAGE_UTIL_LINUX=y
BR2_PACKAGE_UTIL_LINUX_SCHEDUTILS=y
BR2_TARGET_ROOTFS_CPIO=y
BR2_TARGET_ROOTFS_CPIO_GZIP=y
# BR2_TARGET_ROOTFS_TAR is not set
BR2_PACKAGE_HOST_E2FSPROGS=y
# Required for HPC Challenge benchmark
BR2_PACKAGE_IFUPDOWN_SCRIPTS=y
# Add Switch Tools
BR2_PACKAGE_TCPDUMP=y
BR2_PACKAGE_ETHTOOL=y

# Base Python3 installation
# BR2_PACKAGE_HOST_GDB_PYTHON3 is not set
# BR2_PACKAGE_PYTHON3 is not set

# BR2_PACKAGE_OPENSSH=y
# BR2_PACKAGE_OPENSSH_CLIENT=y
# BR2_PACKAGE_OPENSSH_SERVER=y

#
# P64H Packages
#
BR2_PACKAGE_P64H=y
BR2_PACKAGE_P64H_PLATFORM="qemu"
BR2_PACKAGE_P64H_EXAMPLES=y
BR2_PACKAGE_P64H_EXAMPLES_HELLO=y
BR2_PACKAGE_P64H_EXAMPLES_UIO_SHAREDMEM=y
BR2_PACKAGE_P64H_EXAMPLES_SPW=y
BR2_PACKAGE_P64H_EXAMPLES_COAP_PING=y
BR2_PACKAGE_P64H_EXAMPLES_LMS_DUMP=y
# BR2_PACKAGE_P64H_EXAMPLES_UTILS is not set
# BR2_PACKAGE_P64H_EXAMPLES_TEST_AUTOMATION is not set
BR2_PACKAGE_P64H_TEST_TOOLS=y
BR2_PACKAGE_P64H_BENCHMARKS=y
BR2_PACKAGE_P64H_BENCHMARKS_COREMARK=y
BR2_PACKAGE_P64H_BENCHMARKS_HACC=y
BR2_PACKAGE_P64H_BENCHMARKS_HPCC=y
BR2_PACKAGE_P64H_BENCHMARKS_HPEC_CHALLENGE=y
BR2_PACKAGE_P64H_BENCHMARKS_MICROBENCH=y
BR2_PACKAGE_P64H_BENCHMARKS_PERLIN=y
BR2_PACKAGE_P64H_BENCHMARKS_SPACEBENCH=y
BR2_PACKAGE_P64H_BENCHMARKS_STREAM=y
# BR2_PACKAGE_P64H_LIBS is not set
# BR2_PACKAGE_P64H_OPENBLAS is not set
# BR2_PACKAGE_P64H_OPENMPI is not set
# BR2_PACKAGE_P64H_LIBS_LIBGFORTRAN is not set
# BR2_PACKAGE_P64H_LIBS_LIBC is not set
BR2_PACKAGE_P64H_LKMS=y
# BR2_PACKAGE_P64H_LKMS_UIO_SHAREDMEM_DRIVER is not set
BR2_PACKAGE_P64H_LKMS_P64H_UIO_DRIVER=y
# BR2_PACKAGE_P64H_LKMS_APPDMA_DRIVER is not set
BR2_PACKAGE_P64H_LKMS_XSPI_DRIVER=y
BR2_PACKAGE_P64H_LKMS_GPIO_DRIVER=y
BR2_PACKAGE_P64H_LKMS_WDT_DRIVER=y
BR2_PACKAGE_P64H_LKMS_HPT_DRIVER=y
BR2_PACKAGE_P64H_LKMS_PCIE_DRIVER=y
```

## configs/p64h_qemu_test_p64h_benchmarks_libs_defconfig
```kconfig
#
# P64H Packages
#
BR2_PACKAGE_P64H=y
BR2_PACKAGE_P64H_BITBUCKET=y
BR2_PACKAGE_P64H_LATEST_VERSION=n
BR2_PACKAGE_P64H_BITBUCKET_SOURCE="https://bitbucket.microchip.com/scm/hpsc/p64h-linux-examples.git"
BR2_PACKAGE_P64H_BITBUCKET_VERSION="HPSC-4292-p64h-linux-examples-remove-any-reference-of-buildroot-external-buildroot-and-linux-kernel" # TO BE UPDATED
BR2_PACKAGE_P64H_EXAMPLES=n
BR2_PACKAGE_P64H_BENCHMARKS=y
BR2_PACKAGE_P64H_BENCHMARKS_COREMARK=y
BR2_PACKAGE_P64H_BENCHMARKS_HACC=y
BR2_PACKAGE_P64H_BENCHMARKS_HPCC=y
BR2_PACKAGE_P64H_BENCHMARKS_HPEC_CHALLENGE=y
BR2_PACKAGE_P64H_BENCHMARKS_MICROBENCH=y
BR2_PACKAGE_P64H_BENCHMARKS_PERLIN=y
BR2_PACKAGE_P64H_BENCHMARKS_SPACEBENCH=y
BR2_PACKAGE_P64H_BENCHMARKS_STREAM=y
# BR2_PACKAGE_P64H_LIBS is not set
# BR2_PACKAGE_P64H_LIBS_OPENBLAS is not set
# BR2_PACKAGE_P64H_LIBS_OPENMPI is not set
# BR2_PACKAGE_P64H_LIBS_LIBGFORTRAN is not set
# BR2_PACKAGE_P64H_LIBS_LIBC is not set
BR2_PACKAGE_P64H_LKMS=n
```

## configs/p64h_qemu_test_p64h_drivers_only_defconfig
```kconfig
#
# P64H Packages
#
BR2_PACKAGE_P64H=y
BR2_PACKAGE_P64H_BITBUCKET=y
BR2_PACKAGE_P64H_LATEST_VERSION=n
BR2_PACKAGE_P64H_BITBUCKET_SOURCE="https://bitbucket.microchip.com/scm/hpsc/p64h-linux-examples.git"
BR2_PACKAGE_P64H_BITBUCKET_VERSION="main"
BR2_PACKAGE_P64H_LKMS=y
BR2_PACKAGE_P64H_LKMS_UIO_SHAREDMEM_DRIVER=y
BR2_PACKAGE_P64H_LKMS_P64H_UIO_DRIVER=y
BR2_PACKAGE_P64H_LKMS_UIO_MESA_DRIVER=y
BR2_PACKAGE_P64H_LKMS_APPDMA_DRIVER=y
BR2_PACKAGE_P64H_LKMS_XSPI_DRIVER=y
BR2_PACKAGE_P64H_LKMS_GPIO_DRIVER=y
BR2_PACKAGE_P64H_LKMS_WDT_DRIVER=y
```

## configs/p64h_qemu_test_p64h_examples_only_defconfig
```kconfig
#
# P64H Packages
#
BR2_PACKAGE_P64H=y
BR2_PACKAGE_P64H_BITBUCKET=y
BR2_PACKAGE_P64H_LATEST_VERSION=n
BR2_PACKAGE_P64H_BITBUCKET_SOURCE="https://bitbucket.microchip.com/scm/hpsc/p64h-linux-examples.git"
BR2_PACKAGE_P64H_BITBUCKET_VERSION="main"
BR2_PACKAGE_P64H_EXAMPLES=y
BR2_PACKAGE_P64H_EXAMPLES_HELLO=y
BR2_PACKAGE_P64H_EXAMPLES_UIO_SHAREDMEM=y
BR2_PACKAGE_P64H_BENCHMARKS=n
BR2_PACKAGE_P64H_LIBS=n
BR2_PACKAGE_P64H_LKMS=n
```
