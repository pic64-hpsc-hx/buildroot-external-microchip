## configs/p64h_test_defconfig
```kconfig
BR2_riscv=y
BR2_TOOLCHAIN_EXTERNAL=y
BR2_TOOLCHAIN_EXTERNAL_P64H=y
BR2_TOOLCHAIN_EXTERNAL_PREINSTALLED=y
BR2_TOOLCHAIN_EXTERNAL_PATH="$(RISCV_PATH)"
BR2_PACKAGE_HOST_GDB=y
BR2_PACKAGE_HOST_GDB_TUI=y
BR2_PACKAGE_HOST_GDB_PYTHON3=y
BR2_GDB_VERSION_16=y
BR2_CCACHE=y
BR2_OPTIMIZE_S=y
BR2_PACKAGE_OVERRIDE_FILE="$(BR2_EXTERNAL_P64H_PACKAGE_OVERRIDE_FILE)"
BR2_TARGET_GENERIC_HOSTNAME="p64h-test"
BR2_TARGET_GENERIC_ISSUE="Welcome to PIC64 HPSC/HX Buildroot"
BR2_ROOTFS_DEVICE_CREATION_STATIC=y
BR2_ROOTFS_OVERLAY="$(BR2_EXTERNAL_MCHP_PATH)/board/microchip/p64h/p64h/overlay/"
BR2_ROOTFS_POST_BUILD_SCRIPT="$(BR2_EXTERNAL_MCHP_PATH)/board/microchip/p64h/common-scripts/compress_image.sh"
BR2_LINUX_KERNEL=y
BR2_LINUX_KERNEL_CUSTOM_GIT=y
BR2_LINUX_KERNEL_CUSTOM_REPO_URL="git@github.com:pic64-hpsc-hx/linux.git"
BR2_LINUX_KERNEL_CUSTOM_REPO_VERSION="3899d187533b87f8c2d4b012978d89d19e4c219a"
BR2_LINUX_KERNEL_DEFCONFIG="p64h_test"
BR2_PACKAGE_LINUX_TOOLS_PERF=y
BR2_PACKAGE_BUSYBOX_CONFIG="$(BR2_EXTERNAL_MCHP_PATH)/board/microchip/p64h/p64h/busybox.config"
BR2_PACKAGE_GDB=y
BR2_PACKAGE_GDB_SERVER=y
BR2_PACKAGE_GDB_DEBUGGER=y
BR2_PACKAGE_GDB_TUI=y
BR2_PACKAGE_STRESS_NG=y
BR2_PACKAGE_SSHFS=y
BR2_PACKAGE_LINUX_FIRMWARE=y
BR2_PACKAGE_LINUX_FIRMWARE_MICROCHIP_VSC85XX_PHY=y
BR2_PACKAGE_MDIO_TOOLS=y
BR2_PACKAGE_MEMTESTER=y
BR2_PACKAGE_NVME=y
BR2_PACKAGE_LIBNVME=y
BR2_PACKAGE_PCIUTILS=y
BR2_PACKAGE_LIBCONFUSE=y
BR2_PACKAGE_LIBUEV=y
BR2_PACKAGE_LIBITE=y
BR2_PACKAGE_HAVEGED=y
BR2_PACKAGE_ETHTOOL=y
BR2_PACKAGE_TCPDUMP=y
BR2_PACKAGE_CPULOAD=y
BR2_PACKAGE_NUMACTL=y
BR2_PACKAGE_UTIL_LINUX_SCHEDUTILS=y
BR2_PACKAGE_UTIL_LINUX_WDCTL=y
BR2_TARGET_ROOTFS_CPIO=y
BR2_TARGET_ROOTFS_CPIO_GZIP=y
# BR2_TARGET_ROOTFS_TAR is not set
BR2_PACKAGE_HOST_E2FSPROGS=y
BR2_PACKAGE_P64H=y
BR2_PACKAGE_P64H_BENCHMARKS=y
BR2_PACKAGE_P64H_BENCHMARKS_ATOMICS=y
BR2_PACKAGE_P64H_BENCHMARKS_COREMARK=y
BR2_PACKAGE_P64H_BENCHMARKS_HACC=y
BR2_PACKAGE_P64H_BENCHMARKS_HPCC=y
BR2_PACKAGE_P64H_BENCHMARKS_HPEC_CHALLENGE=y
BR2_PACKAGE_P64H_BENCHMARKS_MICROBENCH=y
BR2_PACKAGE_P64H_BENCHMARKS_PERLIN=y
BR2_PACKAGE_P64H_BENCHMARKS_SPACEBENCH=y
BR2_PACKAGE_P64H_BENCHMARKS_ROOFLINE=y
BR2_PACKAGE_P64H_BENCHMARKS_HPFEC=y
BR2_PACKAGE_P64H_BENCHMARKS_STREAM=y
BR2_PACKAGE_P64H_EXAMPLES=y
BR2_PACKAGE_P64H_EXAMPLES_HELLO=y
BR2_PACKAGE_P64H_EXAMPLES_RPMI_RAS=y
BR2_PACKAGE_P64H_EXAMPLES_UIO_SHAREDMEM=y
BR2_PACKAGE_P64H_EXAMPLES_SPW=y
BR2_PACKAGE_P64H_EXAMPLES_COAP_PING=y
BR2_PACKAGE_P64H_EXAMPLES_LMS_DUMP=y
BR2_PACKAGE_P64H_EXAMPLES_TEST_AUTOMATION=y
BR2_PACKAGE_P64H_EXAMPLES_IPC_TEST=y
BR2_PACKAGE_P64H_EXAMPLES_CACHE_UIO_TEST=y
BR2_PACKAGE_P64H_EXAMPLES_COAP_PROXY=y
BR2_PACKAGE_P64H_RPMID=y
BR2_PACKAGE_P64H_LKMS_P64H_UIO_DRIVER=y
BR2_PACKAGE_P64H_LKMS_XSPI_DRIVER=y
BR2_PACKAGE_P64H_LKMS_GPIO_DRIVER=y
BR2_PACKAGE_P64H_LKMS_WDT_DRIVER=y
BR2_PACKAGE_P64H_LKMS_HPT_DRIVER=y
BR2_PACKAGE_P64H_LKMS_IPC_DEMO_DRIVER=y
BR2_PACKAGE_P64H_LKMS_PCIE_DRIVER=y
BR2_PACKAGE_P64H_LKMS_X288_L2PF_DRIVER=y
BR2_PACKAGE_P64H_TEST_TOOLS=y
```

## configs/p64h_xen_defconfig
```kconfig
BR2_riscv=y
BR2_STRIP_strip=y
BR2_CCACHE=y
BR2_PACKAGE_OVERRIDE_FILE="$(BR2_EXTERNAL_P64H_PACKAGE_OVERRIDE_FILE)"
BR2_TARGET_GENERIC_HOSTNAME="p64h-qemu-xen"
BR2_TARGET_GENERIC_ISSUE="Welcome to PIC64 HPSC/HX QEMU Buildroot"
BR2_ROOTFS_DEVICE_CREATION_STATIC=y
BR2_ROOTFS_OVERLAY="$(BR2_EXTERNAL_MCHP_PATH)/board/microchip/p64h/xen/overlay/"
BR2_PACKAGE_BUSYBOX_CONFIG="$(BR2_EXTERNAL_MCHP_PATH)/board/microchip/p64h/xen/busybox.config"
BR2_ROOTFS_POST_BUILD_SCRIPT="$(BR2_EXTERNAL_MCHP_PATH)/board/microchip/p64h/common-scripts/compress_image.sh"
#
# Kernel
#
BR2_LINUX_KERNEL=y
BR2_LINUX_KERNEL_CUSTOM_TARBALL=y
BR2_LINUX_KERNEL_CUSTOM_TARBALL_LOCATION="https://github.com/pic64-hpsc-hx/linux/archive/refs/tags/linux4microchip+p64h-2024.07-rc1.tar.gz"
BR2_LINUX_KERNEL_VERSION="custom"
BR2_LINUX_KERNEL_USE_CUSTOM_CONFIG=y
BR2_LINUX_KERNEL_CUSTOM_CONFIG_FILE="$(BR2_EXTERNAL_MCHP_PATH)/board/microchip/p64h/xen/linux.config"
BR2_LINUX_KERNEL_CONFIG_FRAGMENT_FILES=""
BR2_LINUX_KERNEL_CUSTOM_LOGO_PATH=""
BR2_LINUX_KERNEL_IMAGE=y
BR2_LINUX_KERNEL_GZIP=y

# GCC optimization levels
# optimize for size - -Os enables all -O2 optimizations except those that increase program size
BR2_OPTIMIZE_S=y

BR2_TARGET_ROOTFS_CPIO=y
BR2_TARGET_ROOTFS_CPIO_GZIP=y
# Required for HPC Challenge benchmark
BR2_PACKAGE_IFUPDOWN_SCRIPTS=y
```

## package/p64h-benchmarks/Config.in
```kconfig
config BR2_PACKAGE_P64H_BENCHMARKS
	bool "PIC64-HPSC-HX Benchmarks"
	depends on BR2_PACKAGE_P64H
        select BR2_PACKAGE_HWLOC
	help
	  Linux benchmarks applications for PIC64-HPSC-HX SoC.

config BR2_PACKAGE_P64H_BENCHMARKS_ATOMICS
	bool "atomics"
	depends on BR2_PACKAGE_P64H_BENCHMARKS
	help
	  Atomics benchmark for PIC64-HPSC-HX SoC.

config BR2_PACKAGE_P64H_BENCHMARKS_COREMARK
	bool "coremark"
	depends on BR2_PACKAGE_P64H_BENCHMARKS
	help
	  Coremark benchmark for PIC64-HPSC-HX SoC.

config BR2_PACKAGE_P64H_BENCHMARKS_HACC
	bool "hacc"
	depends on BR2_PACKAGE_P64H_BENCHMARKS
	select BR2_PACKAGE_P64H_LIBS_OPENMP
	help
	  hacc benchmark for PIC64-HPSC-HX SoC.

config BR2_PACKAGE_P64H_BENCHMARKS_HPCC
	bool "hpcc"
	depends on BR2_PACKAGE_P64H_BENCHMARKS
	select BR2_PACKAGE_P64H_LIBS
	select BR2_PACKAGE_P64H_OPENBLAS
	select BR2_PACKAGE_P64H_OPENMPI
	select BR2_PACKAGE_P64H_LIBS_LIBGFORTRAN
	select BR2_PACKAGE_P64H_LIBS_LIBC
	select BR2_PACKAGE_P64H_LIBS_OPENMP
	select BR2_PACKAGE_OPENSSH
	select BR2_PACKAGE_IFUPDOWN_SCRIPTS
	select BR2_PACKAGE_LIBZLIB
	select BR2_PACKAGE_HWLOC
	help
	  hpcc benchmark for PIC64-HPSC-HX SoC.

config BR2_PACKAGE_P64H_BENCHMARKS_HPEC_CHALLENGE
	bool "hpec_challenge"
	depends on BR2_PACKAGE_P64H_BENCHMARKS
	help
	  HPEC Challenge benchmark for PIC64-HPSC-HX SoC.

config BR2_PACKAGE_P64H_BENCHMARKS_MICROBENCH
	bool "microbench"
	depends on BR2_PACKAGE_P64H_BENCHMARKS
	help
	  Microbench benchmark for PIC64-HPSC-HX SoC.

config BR2_PACKAGE_P64H_BENCHMARKS_PERLIN
	bool "perlin"
	depends on BR2_PACKAGE_P64H_BENCHMARKS
	select BR2_PACKAGE_P64H_LIBS_OPENMP
	help
	  Perlin benchmark for PIC64-HPSC-HX SoC.

config BR2_PACKAGE_P64H_BENCHMARKS_SPACEBENCH
	bool "Spacebench"
	depends on BR2_PACKAGE_P64H_BENCHMARKS
	select BR2_PACKAGE_P64H_LIBS
	select BR2_PACKAGE_P64H_OPENBLAS
	select BR2_PACKAGE_P64H_LIBS_LIBGFORTRAN
	select BR2_PACKAGE_P64H_LIBS_OPENMP
	help
	  Spacebench benchmark for PIC64-HPSC-HX SoC.

config BR2_PACKAGE_P64H_BENCHMARKS_ROOFLINE
	bool "roofline"
	depends on BR2_PACKAGE_P64H_BENCHMARKS
	help
	  Empirical Roofline Tool benchmark for PIC64-HPSC-HX SoC.

config BR2_PACKAGE_P64H_BENCHMARKS_HPFEC
	bool "hpfec"
	depends on BR2_PACKAGE_P64H_BENCHMARKS
	help
	  HPFEC benchmark for PIC64-HPSC-HX SoC.

config BR2_PACKAGE_P64H_BENCHMARKS_STREAM
	bool "STREAM"
	depends on BR2_PACKAGE_P64H_BENCHMARKS
	select BR2_PACKAGE_P64H_LIBS_OPENMP
	help
	  STREAM benchmark for PIC64-HPSC-HX SoC.
```

## package/p64h-examples/Config.in
```kconfig
config BR2_PACKAGE_P64H_EXAMPLES
	bool "PIC64-HPSC-HX Examples"
	depends on BR2_PACKAGE_P64H
	help
	  Linux example applications package for PIC64-HPSC-HX SoC.

config BR2_PACKAGE_P64H_EXAMPLES_HELLO
	bool "hello world"
	depends on BR2_PACKAGE_P64H_EXAMPLES
	help
	  Hello World application for PIC64-HPSC-HX SoC.

config BR2_PACKAGE_P64H_EXAMPLES_RPMI_RAS
	bool "rpmi ras"
	depends on BR2_PACKAGE_P64H_EXAMPLES
	help
	  RPMI RAS example application for PIC64-HPSC-HX SoC.

config BR2_PACKAGE_P64H_EXAMPLES_UIO_SHAREDMEM
	bool "uio sharedmem"
	depends on BR2_PACKAGE_P64H_EXAMPLES
	select BR2_PACKAGE_P64H_LKMS
	select BR2_PACKAGE_P64H_LKMS_UIO_SHAREDMEM_DRIVER
	help
	  This application demonstrates shared memory operations between
	  the application clusters on PIC64-HPSC-HX SoC.

	  This application utilizes UIO (Userspace I/O) framework to manage
	  shared memory operations on the PIC64-HPSC-HX SoC.
		
config BR2_PACKAGE_P64H_EXAMPLES_SPW
	bool "SpaceWire"
	depends on BR2_PACKAGE_P64H_EXAMPLES
	help
	  SpaceWire test application for PIC64-HPSC-HX SoC.

config BR2_PACKAGE_P64H_EXAMPLES_COAP_PING
	bool "CoAP Ping"
	depends on BR2_PACKAGE_P64H_EXAMPLES
	help
	  Coap Ping test application for PIC64-HPSC-HX SoC.

config BR2_PACKAGE_P64H_EXAMPLES_LMS_DUMP
	bool "LMS Dump"
	depends on BR2_PACKAGE_P64H_EXAMPLES
	help
	  LMS Dump developer tool for PIC64-HPSC-HX SoC.

config BR2_PACKAGE_P64H_EXAMPLES_UTILS
	bool "utils"
	depends on BR2_PACKAGE_P64H_EXAMPLES
	help
	  Utility tool for PIC64-HPSC-HX SoC.

	  Enables file transfer between a host filesystem
	  and a Linux filesystem on the target device. It leverages 
	  p64h_semihost library internally.

config BR2_PACKAGE_P64H_EXAMPLES_TEST_AUTOMATION
	bool "test automation tools"
	depends on BR2_PACKAGE_P64H_EXAMPLES
	select BR2_PACKAGE_P64H_EXAMPLES_UTILS
	select BR2_PACKAGE_PYTHON3
	help
	  Utilities for helping to automate tests on the PIC64-HPSC-HX SoC.

config BR2_PACKAGE_P64H_EXAMPLES_TFPGA_SPI_MEM_DRIVER
    bool "Enable tfpga spi memory driver"
    help
      Enable support for TFPGA spi memory mtd driver 

config BR2_PACKAGE_P64H_EXAMPLES_IPC_TEST
	bool "Test IPC driver"
	depends on BR2_PACKAGE_P64H_EXAMPLES
	select BR2_PACKAGE_P64H_LKMS
	select BR2_PACKAGE_P64H_LKMS_IPC_DEMO_DRIVER
	help
	  IPC test application for P64H-IPC driver

config BR2_PACKAGE_P64H_EXAMPLES_CACHE_UIO_TEST
	bool "Test cache uio"
	depends on BR2_PACKAGE_P64H_EXAMPLES
	help
	  Cache uio test application for PIC64-HPSC-HX SoC

config BR2_PACKAGE_P64H_EXAMPLES_COAP_PROXY
    bool "p64h coap proxy"
    help
      CoAP proxy daemon for relaying CoAP messages
```

## package/p64h-libs/Config.in
```kconfig
config BR2_PACKAGE_P64H_LIBS
	bool "PIC64-HPSC-HX Shared Libraries"
	depends on BR2_PACKAGE_P64H
	help
	  Enable this option to include shared libraries
	  and dependencies for PIC64-HPSC-HX SoC.

	  This package provides essential libraries and 
	  dependencies required for PIC64-HPSC-HX SoC.

	  If unsure, leave this option enabled.

source "$BR2_EXTERNAL_MCHP_PATH/package/p64h-openblas/Config.in"

source "$BR2_EXTERNAL_MCHP_PATH/package/p64h-openmpi/Config.in"

config BR2_PACKAGE_P64H_LIBS_LIBGFORTRAN
	bool "libgfortran"
	depends on BR2_PACKAGE_P64H_LIBS
	help
	  Enable this option to include libgfortran,
	  a library providing Fortran runtime support
	  for applications on the PIC64-HPSC-HX SoC.
	  
	  If unsure, leave this option enabled.

config BR2_PACKAGE_P64H_LIBS_LIBC
	bool "libc"
	depends on BR2_PACKAGE_P64H_LIBS
	help
	  Enable this option to include the C Library (libc),
	  providing fundamental routines for system programming
	  on the PIC64-HPSC-HX SoC.
	  
	  If unsure, leave this option enabled.

config BR2_PACKAGE_P64H_LIBS_OPENMP
	bool "openmp"
	depends on BR2_PACKAGE_P64H_LIBS
	help
	  Enable this option to include OpenMP,
	  a library providing OpenMP runtime support
	  for applications on the PIC64-HPSC-HX SoC.
```

## package/p64h-lkms/Config.in
```kconfig
comment "p64h-lkms needs a Linux kernel to be built"
	depends on !BR2_LINUX_KERNEL

config BR2_PACKAGE_P64H_LKMS
	bool "PIC64-HPSC-HX Kernel Drivers"
	depends on BR2_PACKAGE_P64H
	depends on BR2_LINUX_KERNEL
	help
	  Add custom Linux kernel drivers package for PIC64-HPSC-HX SoC.

config BR2_PACKAGE_P64H_LKMS_UIO_SHAREDMEM_DRIVER
	bool "Enable uio sharedmem driver"
	depends on BR2_PACKAGE_P64H_LKMS
	help
      Enable support for the uio-sharedmem-driver, necessary for the uio-sharedmem
      userland application demo. This driver enables shared memory operations
	  between the application clusters using the UIO (Userspace I/O) framework.

config BR2_PACKAGE_P64H_LKMS_P64H_UIO_DRIVER
	bool "Enable uio p64h Generic driver"
	depends on BR2_PACKAGE_P64H_LKMS
	help
	  Enable support to P64H Application Complex UIO Generic Device
	  driver used to memory map any memory or peripheral in user space.

config BR2_PACKAGE_P64H_LKMS_XSPI_DRIVER
	bool "Enable P64H xspi driver"
	depends on BR2_PACKAGE_P64H_LKMS
	help
	  Enable support for P64H Application Complex XSPI driver.

config BR2_PACKAGE_P64H_LKMS_GPIO_DRIVER
	bool "Enable P64H gpio driver"
	depends on BR2_PACKAGE_P64H_LKMS
	help
	  Enable support for P64H Application Complex GPIO driver.

config BR2_PACKAGE_P64H_LKMS_WDT_DRIVER
	bool "Enable P64H watchdog driver"
	depends on BR2_PACKAGE_P64H_LKMS
	help
	  Enable support for P64H Application Complex watchdog driver.

config BR2_PACKAGE_P64H_LKMS_HPT_DRIVER
	bool "Enable P64H High Precision Timer driver"
	depends on BR2_PACKAGE_P64H_LKMS
	help
	  Enable support for P64H Application Complex High Precision Timer driver.

config BR2_PACKAGE_P64H_LKMS_IPC_DEMO_DRIVER
	bool "Enable P64H Inter Processor Communication(IPC) driver"
	depends on BR2_PACKAGE_P64H_LKMS
	help
	  Enable support for P64H Application Complex IPC driver.

config BR2_PACKAGE_P64H_LKMS_PCIE_DRIVER
	bool "Enable P64H PCIe driver"
	depends on BR2_PACKAGE_P64H_LKMS
	help
	  Enable support for P64H Application Complex PCIe bridge controller driver.

config BR2_PACKAGE_P64H_LKMS_X288_L2PF_DRIVER
        bool "Enable X288 L2 Perfetcher driver"
        depends on BR2_PACKAGE_P64H_LKMS
        help
          Enable support for P64H Application Complex X288 L2 Perfetcher driver.

config BR2_PACKAGE_P64H_LKMS_PIE_DRIVER
        bool "Enable P64H PIE driver"
        depends on BR2_PACKAGE_P64H_LKMS
        help
          Enable support for P64H Application Complex Packet Insert Extract
          (PIE) driver.

config BR2_PACKAGE_P64H_LKMS_RDMA_DRIVER
        bool "Enable P64H RDMA driver"
        depends on BR2_PACKAGE_P64H_LKMS
        help
          Enable support for P64H Application Complex RDMA driver.
```

## package/p64h-openblas/Config.in
```kconfig
config BR2_PACKAGE_P64H_OPENBLAS
	bool "OpenBLAS"
	depends on BR2_PACKAGE_P64H_LIBS
	help
	  Enable this option to include OpenBLAS,
	  an optimized BLAS library for PIC64-HPSC-HX SoC.
	  
	  If unsure, leave this option enabled.
```

## package/p64h-openmpi/Config.in
```kconfig
config BR2_PACKAGE_P64H_OPENMPI
	bool "OpenMPI"
	depends on BR2_PACKAGE_P64H_LIBS
	help
	  Enable this option to include OpenMPI,
	  a high-performance Message Passing Interface (MPI) library
	  for parallel computing on the PIC64-HPSC-HX SoC.
	  
	  If unsure, leave this option enabled.
```

## package/p64h-rpmid/Config.in
```kconfig
config BR2_PACKAGE_P64H_RPMID
	bool "PIC64-HPSC-HX RPMI Daemon (sysc_rpmid)"
	depends on BR2_PACKAGE_P64H
	help
	  RPMI daemon (sysc_rpmid) for PIC64-HPSC-HX SoC AppC Linux.

	  sysc_rpmid bridges the SYSC RPMI shared-memory transport to
	  TCP (default port 5685) and CoAP/UDP (default port 5683)
	  listeners, so host tools (e.g. dev_cfg --rpmi-tcp) can drive
	  RPMI requests over the network.

	  This is a long-running utility, packaged separately from the
	  example binaries in P64H_EXAMPLES so it can be installed on
	  systems that do not need the example set.
```

## package/p64h-test-tools/Config.in
```kconfig
config BR2_PACKAGE_P64H_TEST_TOOLS
    bool "Test automation tools"
    depends on BR2_PACKAGE_P64H_EXAMPLES
    select BR2_PACKAGE_PYTHON3
    select BR2_PACKAGE_PYTHON3_PYC_ONLY
    select BR2_PACKAGE_PYTHON_PYTEST
    select BR2_PACKAGE_PYTHON_REGEX
    select BR2_PACKAGE_PYTHON_UNITTEST_XML_REPORTING
    select BR2_PACKAGE_PCIUTILS
    select BR2_PACKAGE_NVME
    select BR2_PACKAGE_E2FSPROGS
    help
      Utilities for helping to automate tests on the PIC64-HPSC-HX SoC.
```
